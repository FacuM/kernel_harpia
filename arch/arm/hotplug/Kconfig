## arch/arm/hotplug/Kconfig
```kconfig
config CLUSTER_PLUG
        bool "Enable cluster-plug cpu hotplug driver"
        default n
        help
          CPU hotplug driver designed for ARM big.LITTLE systems where
          both the big and little CPUs are of the same type. On these
          systems, it preferable to normall use the big cluster, and
          only activate the little cluster for highly parallel loads.
          This hotplug implementation always keeps the big cluster
          online, and only activates the little cluster for heavy
          parallel loads.

config INTELLI_PLUG
        bool "Enable intelli-plug cpu hotplug driver"
        default n
        help
          Generic Intelli-plug cpu hotplug driver for ARM SOCs

config THUNDERPLUG_QUAD_CONTROL
	bool "Enable plugging down/up of cores with/without using LCD NOTIFIER"
	help
	  This driver doesn't uses LCD NOTIFIER to take down the cpu cores on a device Instead uses simple calculations which are tuned to sit perfectly on a quad core device :).

config ASMP
	bool "Multi-core automatic hotplug support"
	depends on SMP
	default n
	help
	  Automatically hotplugs the multiple cpu cores on and off based on cpu load and suspend state
```
